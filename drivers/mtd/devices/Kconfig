## drivers/mtd/devices/Kconfig
```kconfig
# SPDX-License-Identifier: GPL-2.0+

config MTD_MCHP23K256
	bool "Microchip 23K256 and 23LCV1024 SPI SRAM"
	depends on DM_SPI && DM_MTD
	help
	  Enable support for the Microchip 23K256 and 23LCV1024 serial SRAMs,
	  a 32 KiB and a 128 KiB SRAM on an SPI bus, the latter with battery
	  backup. The device is registered as an MTD device of type MTD_RAM,
	  so the mtd command reaches it.

	  Writing needs no erase, so the driver implements none and the MTD
	  flags say MTD_NO_ERASE. An erase request is answered with
	  -EOPNOTSUPP rather than silently doing nothing.

	  If unsure, say N

config MTD_MCHP23K256_SANDBOX
	bool "Sandbox emulation of the Microchip 23LCV1024"
	depends on SANDBOX && MTD_MCHP23K256
	help
	  Emulate a 23LCV1024 on the sandbox SPI bus, so that the driver can
	  be exercised by the unit tests. The emulation implements all three
	  operating modes of the device, which is what makes it able to tell
	  whether the driver selects the right one.
```
