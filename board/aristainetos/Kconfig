## board/aristainetos/Kconfig
```kconfig
if TARGET_ARISTAINETOS2

source "board/aristainetos/common/Kconfig"

config SYS_BOARD
	default "aristainetos"

config SYS_CONFIG_NAME
	default "aristainetos2"

config SYS_BOARD_VERSION
	default 2

endif
```

## drivers/crypto/fsl/Kconfig
```kconfig
config FSL_CAAM
	bool "Freescale Crypto Driver Support"
	#
	# The FSL-CAAM driver requires DMA-allocated buffers for input and output,
	# which nobody thought about when committing this driver.
	# This breaks autoboot.c as well as cmd_hash.
	# On the console you see:
	#   Error: Address arguments are not aligned
	#   CAAM was not setup properly or it is faulty
	# Disable the HW_ACCEL feature for now, u-boot uses software functions in that case.
	# The boot-image check always use the software functions and there for will not fail.
	#
	#  select SHA_HW_ACCEL
	imply CMD_HASH
	help
	  Enables the Freescale's Cryptographic Accelerator and Assurance
	  Module (CAAM), also known as the SEC version 4 (SEC4). The driver uses
	  Job Ring as interface to communicate with CAAM.

config SYS_FSL_HAS_SEC
	bool
	help
		Enable Freescale Secure Boot and Trusted Architecture

config SYS_FSL_SEC_COMPAT_2
	bool
	help
		Secure boot and trust architecture compatible version 2

config SYS_FSL_SEC_COMPAT_4
	bool
	help
		Secure boot and trust architecture compatible version 4

config SYS_FSL_SEC_COMPAT_5
	bool
	help
		Secure boot and trust architecture compatible version 5

config SYS_FSL_SEC_COMPAT_6
	bool
	help
		Secure boot and trust architecture compatible version 6

config SYS_FSL_SEC_BE
	bool "Big-endian access to Freescale Secure Boot"

config SYS_FSL_SEC_COMPAT
	int "Freescale Secure Boot compatibility"
	depends on SYS_FSL_HAS_SEC
	default 2 if SYS_FSL_SEC_COMPAT_2
	default 4 if SYS_FSL_SEC_COMPAT_4
	default 5 if SYS_FSL_SEC_COMPAT_5
	default 6 if SYS_FSL_SEC_COMPAT_6

config SYS_FSL_SEC_LE
	bool "Little-endian access to Freescale Secure Boot"
```
